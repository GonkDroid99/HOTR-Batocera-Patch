## buildroot/recipes/package/batocera/emulators/pcsx2-lightgun/Config.in
```kconfig
config BR2_PACKAGE_PCSX2_LIGHTGUN
    bool "pcsx2-lightgun"
    depends on BR2_x86_64
    depends on BR2_PACKAGE_XORG7
    select BR2_PACKAGE_ALSA_LIB
    select BR2_PACKAGE_BATOCERA_QT6
    select BR2_PACKAGE_ECM
    select BR2_PACKAGE_FREETYPE
    select BR2_PACKAGE_KDDOCKWIDGETS
    select BR2_PACKAGE_LIBAIO
    select BR2_PACKAGE_LIBBACKTRACE
    select BR2_PACKAGE_LIBCURL
    select BR2_PACKAGE_LIBGTK3
    select BR2_PACKAGE_LIBPCAP
    select BR2_PACKAGE_LIBPNG
    select BR2_PACKAGE_LIBSAMPLERATE
    select BR2_PACKAGE_LIBSOUNDTOUCH
    select BR2_PACKAGE_PLUTOSVG
    select BR2_PACKAGE_PORTAUDIO
    select BR2_PACKAGE_SDL3
    select BR2_PACKAGE_SHADERC
    select BR2_PACKAGE_VULKAN_HEADERS    if BR2_PACKAGE_BATOCERA_VULKAN
    select BR2_PACKAGE_VULKAN_LOADER     if BR2_PACKAGE_BATOCERA_VULKAN
    select BR2_PACKAGE_WEBP
    select BR2_PACKAGE_WXWIDGETS
    select BR2_PACKAGE_YAML_CPP
    select BR2_PACKAGE_ZLIB
    help
      PCSX2 LightGun Edition - PlayStation 2 emulator with
      MameHooker integration for recoil and light gun effects
      via Hook of the Reaper.

      https://github.com/PCSX2/pcsx2
```
